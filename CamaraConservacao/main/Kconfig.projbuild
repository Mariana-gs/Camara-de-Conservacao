## CamaraConservacao/main/Kconfig.projbuild
```kconfig
menu "Configuração do Wifi Configuration"

    config ESP_WIFI_SSID
        string "wifi SSID"
        default ""
        help
            Nome da rede WiFi.

    config ESP_WIFI_PASSWORD
        string "Senha do Wifi"
        default ""
        help
            Senha do WiFi (WPA or WPA2).

    config ESP_MAXIMUM_RETRY
        int "Número máximo de tentativas de conexão"
        default 10
        help
            Configure o valor máximo de tentativas de conexão.
endmenu
```
